## conf/bblayers.conf
```bitbake
# POKY_BBLAYERS_CONF_VERSION is increased each time build/conf/bblayers.conf
# changes incompatibly
POKY_BBLAYERS_CONF_VERSION = "2"

BBPATH = "${TOPDIR}"
BBFILES ?= ""

BBLAYERS ?= " \
  ${HOME}/Documents/poky/meta \
  ${HOME}/Documents/poky/meta-poky \
  ${HOME}/Documents/poky/meta-yocto-bsp \
  ${HOME}/Documents/poky/meta-raspberrypi \
  ${HOME}/Documents/poky/meta-openembedded/meta-oe \
  ${HOME}/Documents/poky/meta-openembedded/meta-python \
  ${HOME}/Documents/poky/meta-user \
  /home/christopher/Documents/poky/build/workspace \
  "
```
